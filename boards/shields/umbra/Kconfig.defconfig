## boards/shields/umbra/Kconfig.defconfig
```kconfig
# Copyright (c) 2022 The ZMK Contributors
# SPDX-License-Identifier: MIT

if SHIELD_UMBRA

config ZMK_KEYBOARD_NAME
    default "umbra"

endif
```
